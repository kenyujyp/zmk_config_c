## boards/arm/lpgalaxy_le_zapybara/Kconfig.board
```kconfig
# Copyright (c) 2025 The ZMK Contributors
# SPDX-License-Identifier: MIT

config BOARD_LPGALAXY_LE_ZAPYBARA
    bool "lpgalaxy_le_zapybara"
    select ZMK_KSCAN_EC_MATRIX_FAKE_OPEN_DRAIN
    imply ZMK_KSCAN_EC_MATRIX_DYNAMIC_POLL_RATE
    depends on SOC_NRF52840_QIAA
```

## boards/arm/lpgalaxy_le_zapybara/Kconfig.defconfig
```kconfig
# Copyright (c) 2025 The ZMK Contributors
# SPDX-License-Identifier: MIT

if BOARD_LPGALAXY_LE_ZAPYBARA

config ZMK_KEYBOARD_NAME
  default "ec_board"

endif
```

## config/boards/shields/lpgalaxy_le_zapybara/Kconfig.defconfig
```kconfig
# SPDX-License-Identifier: MIT

#config BOARD_ENABLE_DCDC
#    bool "Enable DCDC mode"
#    select SOC_DCDC_NRF52X
#    default y
#    depends on BOARD_LPGALAXY_LE_ZAPYBARA

if SHIELD_LPGALAXY_LE_ZAPYBARA

config ZMK_KEYBOARD_NAME
  default "ec_board"

endif


if ZMK_BATTERY_REPORTING

choice ZMK_BATTERY_REPORTING_FETCH_MODE
	default ZMK_BATTERY_REPORTING_FETCH_MODE_LITHIUM_VOLTAGE
endchoice

endif
```

## config/boards/shields/lpgalaxy_le_zapybara/Kconfig.shield
```kconfig
config SHIELD_LPGALAXY_LE_ZAPYBARA
    def_bool $(shields_list_contains,lpgalaxy_le_zapybara)
```

## config/west.yml
```yaml
manifest:
  remotes:
  - name: zmkfirmware
    url-base: https://github.com/zmkfirmware
  - name: petejohanson
    url-base: https://github.com/petejohanson
  - name: kenyujy
    url-base: https://github.com/kenyujyp
  # Additional modules containing boards/shields/custom code can be listed here as well
  # See https://docs.zephyrproject.org/3.2.0/develop/west/manifest.html#projects
  # imported ec module, for EC function!!!
  projects:
    - name: zmk
      remote: zmkfirmware
      revision: main
      import: app/west.yml
    - name: ec-support-zmk-module
      remote: petejohanson
      revision: main
    - name: zmk-shell-cmd
      remote: kenyujy
      revision: main
  self:
    path: config
```
